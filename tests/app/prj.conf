## CMakeLists.txt
```
cmake_minimum_required(VERSION 3.20.0)
find_package(Zephyr REQUIRED HINTS $ENV{ZEPHYR_BASE})
project(app_test)

target_sources(app PRIVATE src/main.c)
```

## prj.conf
```kconfig
CONFIG_CAN=y

CONFIG_TEST_RANDOM_GENERATOR=y
CONFIG_TIMER_RANDOM_GENERATOR=y

CONFIG_CAN_PRINTER=y

CONFIG_CAN_PRINTER_START_MSG=y
CONFIG_CAN_PRINTER_START_MSG_ID=0x100
CONFIG_CAN_PRINTER_STOP_MSG=y
CONFIG_CAN_PRINTER_STOP_MSG_ID=0x200
CONFIG_CAN_PRINTER_HELLO_MSG=y
CONFIG_CAN_PRINTER_HELLO_MSG_ID=0x300

CONFIG_CAN_SENDER=y
CONFIG_CAN_SENDER_TX_0_MSG_ID=0x000
CONFIG_CAN_SENDER_TX_0_MSG_PERIOD_MS=350
CONFIG_CAN_SENDER_TX_1_MSG_ID=0x001
CONFIG_CAN_SENDER_TX_1_MSG_PERIOD_MS=450
CONFIG_CAN_SENDER_TX_2_MSG_ID=0x002
CONFIG_CAN_SENDER_TX_2_MSG_PERIOD_MS=550
```

## src/main.c
```c
#include <zephyr/device.h>
#include <zephyr/devicetree.h>
#include <zephyr/drivers/can.h>

#include "can_printer.h"
#include "can_sender.h"

const struct device *can_dev = DEVICE_DT_GET(DT_CHOSEN(zephyr_canbus));

static void send_empty_frame(uint32_t msg_id)
{
	struct can_frame frame = {0};

	frame.id = msg_id;
	frame.dlc = 0;

	can_send(can_dev, &frame, K_MSEC(100), NULL, NULL);
}

/**
 *  This test sends a start message after one second and a stop message after another second,
 *  folllowed by a hello message.
 *
 *  A console harness will capture the output and verify that CAN frames are printed between the
 *  start and stop messages only. The hello message is always printed.
 */
int main(void)
{
	can_set_mode(can_dev, CAN_MODE_NORMAL | CAN_MODE_LOOPBACK);
	can_start(can_dev);

	can_printer_init(can_dev);
	can_sender_init(can_dev);

	printk("TEST_BEGIN_MARKER\n");

	k_sleep(K_SECONDS(1));
	send_empty_frame(CONFIG_CAN_PRINTER_START_MSG_ID);

	k_sleep(K_SECONDS(1));
	send_empty_frame(CONFIG_CAN_PRINTER_STOP_MSG_ID);

	k_sleep(K_SECONDS(1));
	send_empty_frame(CONFIG_CAN_PRINTER_HELLO_MSG_ID);

	k_sleep(K_SECONDS(1));
	printk("TEST_END_MARKER\n");

	return 0;
}
```
