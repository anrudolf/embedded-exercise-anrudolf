## Kconfig
```
menu "CAN message printer app"

config APP_CAN_LOOPBACK
    bool "Start CAN in loopback mode"

endmenu

menu "Zephyr"
source "Kconfig.zephyr"
endmenu

module = APP
module-str = APP
source "subsys/logging/Kconfig.template.log_config"
```

## prj.conf
```kconfig
CONFIG_SERIAL=y
CONFIG_SHELL=y
CONFIG_LOG=y

CONFIG_CAN=y
CONFIG_CAN_SHELL=y

CONFIG_CAN_PRINTER=y
CONFIG_CAN_SENDER=y
```

## boards/native_sim.conf
```kconfig
# to separate console and shell to separate pseudo-terminals
CONFIG_LOG_BACKEND_UART=y
CONFIG_SHELL_LOG_BACKEND=n

# to get pseudo randomness on native_sim target
CONFIG_TEST_RANDOM_GENERATOR=y
CONFIG_TIMER_RANDOM_GENERATOR=y
```

## boards/native_sim.overlay
```dts
/ {
	chosen {
		zephyr,console = &uart0;
	    zephyr,shell-uart = &uart1;
	};
};

&uart1 {
	status = "okay";
};
```

## src/main.c
```c
#include <zephyr/device.h>
#include <zephyr/devicetree.h>
#include <zephyr/drivers/can.h>
#include <zephyr/logging/log.h>

#if defined(CONFIG_CAN_PRINTER)
#include "can_printer.h"
#endif

#if defined(CONFIG_CAN_SENDER)
#include "can_sender.h"
#endif

LOG_MODULE_REGISTER(app, CONFIG_APP_LOG_LEVEL);

const struct device *can_dev = DEVICE_DT_GET(DT_CHOSEN(zephyr_canbus));

int main(void)
{
	int err;

#if defined(CONFIG_APP_CAN_LOOPBACK)
	err = can_set_mode(can_dev, CAN_MODE_NORMAL | CAN_MODE_LOOPBACK);
	if (err < 0) {
		LOG_ERR("Error setting CAN into LOOPBACK mode (err %d)", err);
		return err;
	}
#endif

	err = can_start(can_dev);
	if (err < 0) {
		LOG_ERR("Error starting CAN device (err %d)", err);
		return err;
	}

#if defined(CONFIG_CAN_PRINTER)
	err = can_printer_init(can_dev);
	if (err < 0) {
		LOG_ERR("Error initializing CAN printer (err %d)", err);
		return err;
	}
#endif

#if defined(CONFIG_CAN_SENDER)
	err = can_sender_init(can_dev);
	if (err < 0) {
		LOG_ERR("Error initializing CAN sender (err %d)", err);
		return err;
	}
#endif

	return 0;
}
```
