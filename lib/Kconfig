## lib/can_printer/Kconfig
```kconfig
menuconfig CAN_PRINTER
	bool "Support for CAN printer"
	depends on CAN
	help
	  Enables CAN printer for printing CAN messages.


if CAN_PRINTER

config CAN_PRINTER_START_MSG
    bool "Print start message"

config CAN_PRINTER_START_MSG_ID
    hex "Print start message id"
    default "0x040"
    depends on CAN_PRINTER_START_MSG

config CAN_PRINTER_STOP_MSG
    bool "Print stop message"
    
config CAN_PRINTER_STOP_MSG_ID
    hex "Print stop message id"
    default "0x050"
    depends on CAN_PRINTER_STOP_MSG

config CAN_PRINTER_HELLO_MSG
    bool "Print hello message"

config CAN_PRINTER_HELLO_MSG_ID
    hex "Print hello message id"
    default "0x060"
    depends on CAN_PRINTER_HELLO_MSG   


module = CAN_PRINTER
module-str = CAN printer logging
source "subsys/logging/Kconfig.template.log_config"

endif
```

## lib/can_sender/Kconfig
```kconfig
menuconfig CAN_SENDER
	bool "Support for CAN sender"
	depends on CAN
	help
	  Enables CAN sender for sending periodic frames.


if CAN_SENDER

config CAN_SENDER_TX_0_MSG_ID
    hex "TX message 0 id"
    default "0x010"

config CAN_SENDER_TX_0_MSG_PERIOD_MS
    int "TX message 0 period (ms)"
    default 500

config CAN_SENDER_TX_1_MSG_ID
    hex "TX message 1 id"
    default "0x020"

config CAN_SENDER_TX_1_MSG_PERIOD_MS
    int "TX message 1 period (ms)"
    default 1000

config CAN_SENDER_TX_2_MSG_ID
    hex "TX message 2 id"
    default "0x030"

config CAN_SENDER_TX_2_MSG_PERIOD_MS
    int "TX message 2 period (ms)"
    default 2000

config CAN_SENDER_TX_0_MSG_PERIOD_MS
    int "TX message 0 period (ms)"
    default 100

module = CAN_SENDER
module-str = CAN sender logging
source "subsys/logging/Kconfig.template.log_config"

endif
```

## tests/app/testcase.yaml
```yaml
tests:
  app.test:
    tags: app
    platform_allow:
      - native_sim
      - native_sim/native/64
    integration_platforms:
      - native_sim
    harness: console
    harness_config:
      type: multi_line
      regex:
        # Note: the "random" data is deterministic because of CONFIG_TIMER_RANDOM_GENERATOR
        - "TEST_BEGIN_MARKER"
        - "\\(001050\\)       000   \\[8\\]  47 ac a3 0c 12 46 95 36"
        - "\\(001100\\)       002   \\[8\\]  4a 5a b9 11 73 c7 81 6a"
        - "\\(001350\\)       001   \\[8\\]  48 b3 5e 83 34 5e 35 de"
        - "\\(001400\\)       000   \\[8\\]  aa 67 d7 ce 6b bb 6e 90"
        - "\\(001650\\)       002   \\[8\\]  22 64 dd 18 fe 27 27 ee"
        - "\\(001750\\)       000   \\[8\\]  2d 7f 37 c5 af 00 36 1d"
        - "\\(001800\\)       001   \\[8\\]  0b 9e f7 d0 52 2e 30 93"
        - "\\(002020\\)       200   \\[0\\]"
        - "hello specialized"
        - "TEST_END_MARKER"
```

## west.yml
```yaml
manifest:
  remotes:
    - name: zephyrproject-rtos
      url-base: https://github.com/zephyrproject-rtos

  projects:
    - name: zephyr
      remote: zephyrproject-rtos
      revision: main
      west-commands: scripts/west-commands.yml
```
